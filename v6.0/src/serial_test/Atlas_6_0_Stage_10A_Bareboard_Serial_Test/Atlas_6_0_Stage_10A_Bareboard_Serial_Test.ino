/*
  Atlas 6.0 - Stage 10A Bare-Board Serial Protocol Test
  -----------------------------------------------------
  Purpose:
    Validate ESP32 boot safety, serial protocol, ARM/DISARM/STOP,
    heartbeat and heartbeat timeout BEFORE reconnecting any hardware.

  IMPORTANT:
    - BARE BOARD ONLY.
    - No motor GPIOs are configured.
    - No movement can be generated by this firmware.
    - Baud rate: 115200.
*/

#include <Arduino.h>

static const uint32_t SERIAL_BAUD = 115200;
static const uint32_t HEARTBEAT_TIMEOUT_MS = 350;

enum AtlasState {
  STATE_DISARMED,
  STATE_ARMED
};

AtlasState atlasState = STATE_DISARMED;

String rxLine;
uint32_t lastHeartbeatMs = 0;
bool heartbeatActive = false;

void sendLine(const String &s) {
  Serial.println(s);
}

void sendCurrentStatus() {
  if (atlasState == STATE_ARMED) {
    sendLine("STATUS,ARMED");
  } else {
    sendLine("STATUS,DISARMED");
  }
}

void disarmSystem(const char *reason = nullptr) {
  atlasState = STATE_DISARMED;
  heartbeatActive = false;

  if (reason != nullptr) {
    sendLine(String("ERROR,") + reason);
  }

  sendLine("STATUS,DISARMED");
}

void handleCommand(String line) {
  line.trim();

  if (line.length() == 0) {
    return;
  }

  if (line == "CMD,STATUS") {
    sendCurrentStatus();
    return;
  }

  if (line == "CMD,PING") {
    sendLine("ACK,PING");
    return;
  }

  if (line == "CMD,ARM") {
    atlasState = STATE_ARMED;
    lastHeartbeatMs = millis();
    heartbeatActive = true;

    sendLine("ACK,ARM");
    sendLine("STATUS,ARMED");
    return;
  }

  if (line == "CMD,DISARM") {
    atlasState = STATE_DISARMED;
    heartbeatActive = false;

    sendLine("ACK,DISARM");
    sendLine("STATUS,DISARMED");
    return;
  }

  if (line == "CMD,STOP") {
    sendLine("ACK,STOP");
    sendLine("STATUS,STOPPED");
    sendCurrentStatus();
    return;
  }

  if (line == "CMD,HEARTBEAT") {
    if (atlasState != STATE_ARMED) {
      sendLine("ERROR,NOT_ARMED");
      return;
    }

    lastHeartbeatMs = millis();
    heartbeatActive = true;
    sendLine("ACK,HEARTBEAT");
    return;
  }

  if (line.startsWith("CMD,FORWARD") ||
      line.startsWith("CMD,BACKWARD") ||
      line.startsWith("CMD,LEFT") ||
      line.startsWith("CMD,RIGHT")) {
    sendLine("ERROR,BAREBOARD_NO_MOTION");
    return;
  }

  sendLine("ERROR,INVALID_COMMAND");
}

void checkHeartbeatTimeout() {
  if (atlasState != STATE_ARMED || !heartbeatActive) {
    return;
  }

  uint32_t now = millis();

  if ((uint32_t)(now - lastHeartbeatMs) > HEARTBEAT_TIMEOUT_MS) {
    disarmSystem("HEARTBEAT_TIMEOUT");
  }
}

void setup() {
  Serial.begin(SERIAL_BAUD);
  delay(700);

  atlasState = STATE_DISARMED;
  heartbeatActive = false;

  sendLine("STATUS,READY");
  sendLine("STATUS,DISARMED");
  sendLine("INFO,STAGE10A_BAREBOARD");
  sendLine("INFO,BAUD,115200");
  sendLine("INFO,HEARTBEAT_TIMEOUT_MS,350");
}

void loop() {
  while (Serial.available() > 0) {
    char c = (char)Serial.read();

    if (c == '\n') {
      handleCommand(rxLine);
      rxLine = "";
    } else if (c != '\r') {
      if (rxLine.length() < 160) {
        rxLine += c;
      } else {
        rxLine = "";
        sendLine("ERROR,LINE_TOO_LONG");
      }
    }
  }

  checkHeartbeatTimeout();
}
